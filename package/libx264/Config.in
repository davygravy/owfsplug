## package/libx264/Config.in
```kconfig
config BR2_PACKAGE_LIBX264
	bool "libx264"
	help
	  x264 video decoder library

	  http://www.videolan.org/developers/x264.html
```

## package/motion/Config.in
```kconfig
config BR2_PACKAGE_MOTION
        bool "motion"
	depends on BR2_PACKAGE_JPEG
        help
          Motion is a program that monitors the video signal from cameras,
	  detect motion, capture images, etc.

          http://www.lavrsen.dk/foswiki/bin/view/Motion
```

## package/owfs/Config.in
```kconfig
config BR2_PACKAGE_OWFS
        bool "owfs"
        select BR2_PACKAGE_LIBFUSE
        help
          OWFS is an easy way to use the powerful 1-wire system of
          Dallas/Maxim.

          http://owfs.org/
```

## package/temploggerd/Config.in
```kconfig
config BR2_PACKAGE_TEMPLOGGERD
        bool "temploggerd"
 	depends on BR2_PACKAGE_RRDTOOL
	depends on BR2_PACKAGE_OWFS
        help
          Temploggerd is a utility which read temperatures and other data
	  from 1-wire sensors, creates graphs (via rrdtool) and webpages for
	  viewing them.

          http://owfs.org/
```

## package/w3cam/Config.in
```kconfig
config BR2_PACKAGE_W3CAM
        bool "w3cam"
 	depends on BR2_PACKAGE_LIBV4L
	depends on BR2_PACKAGE_JPEG
        help
          W3CAM is a simple video4linux cgi utility that serves
	  webcam images through the http server of your choice.

          http://mpx.freeshell.net/
```
